## local_src/fit-key-debug/debug-image.its
```
/dts-v1/;

/ {
	description = "Signed Debug Image";
	#address-cells = <1>;

	images {
		kernel@1 {
			description = "Kernel for Duckbill";
			data = /incbin/("linuximage");
			type = "kernel";
			arch = "arm";
			os = "linux";
			compression = "none";
			hash@1 {
				algo = "sha1";
			};
		};
		ramdisk@1 {
			description = "InitRAMFS for Duckbill";
			data = /incbin/("root.cpio.gz");
			type = "ramdisk";
			arch = "arm";
			os = "linux";
			compression = "none";
			hash@1 {
				algo = "sha1";
			};
		};
		fdt@1 {
			description = "DTB for Duckbill";
			data = /incbin/("imx28-duckbill.dtb");
			type = "flat_dt";
			arch = "arm";
			compression = "none";
			fdt-version = <1>;
			hash@1 {
				algo = "sha1";
			};
		};
	};
	configurations {
		default = "conf@1";
		conf@1 {
			description = "Default Configuration";
			kernel = "kernel@1";
			ramdisk = "ramdisk@1";
			fdt = "fdt@1";
			signature@1 {
				algo = "sha1,rsa2048";
				key-name-hint = "debug";
				sign-images = "fdt", "ramdisk", "kernel";
			};
		};
	};
};
```
